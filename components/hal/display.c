// DibaVault — display driver (SSD1306/SH1106 over I2C). GPL-3.0. dibachain.
// Text-only, framebuffered. DV_DISPLAY_NONE -> display_available()==false and
// all draw calls are no-ops (confirmation then relies on the button + web/console
// summary). ST7789 is stubbed (returns unavailable) pending a color driver.
#include "display.h"
#include <string.h>
#include <stdio.h>
#include "esp_log.h"
#include "driver/i2c_master.h"

static const char *TAG="disp";
static dv_hal_config_t s_cfg;
static bool s_ready=false;
static i2c_master_bus_handle_t s_bus=NULL;
static i2c_master_dev_handle_t s_dev=NULL;
static uint8_t s_fb[1024];   // 128x64 / 8

// Compact 5x7 font, ASCII 0x20..0x7A (space..'z'). Each glyph = 5 column bytes.
// Bit 0 = top row. Covers digits, upper/lowercase, and common symbols used by
// addresses/amounts. Unknown chars render blank.
static const uint8_t FONT5x7[][5] = {
 {0,0,0,0,0},        // ' '
 {0,0,0x5F,0,0},     // !
 {0,7,0,7,0},        // "
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 {0x44,0x64,0x54,0x4C,0x44}, // z
};

static void ssd1306_cmd(uint8_t c){ uint8_t b[2]={0x00,c}; if(s_dev) i2c_master_transmit(s_dev,b,2,50); }

static void ssd1306_flush(void){
    if(!s_dev) return;
    for(uint8_t page=0; page<(s_cfg.disp_height/8); page++){
        ssd1306_cmd(0xB0|page); ssd1306_cmd(0x00); ssd1306_cmd(0x10);
        uint8_t buf[129]; buf[0]=0x40;
        memcpy(buf+1, s_fb+page*s_cfg.disp_width, s_cfg.disp_width);
        i2c_master_transmit(s_dev, buf, s_cfg.disp_width+1, 50);
    }
}

dv_err_t display_init(const dv_hal_config_t *cfg){
    s_cfg=*cfg; s_ready=false;
    if (cfg->display==DV_DISPLAY_NONE) return DV_OK;
    if (cfg->display==DV_DISPLAY_ST7789) { ESP_LOGW(TAG,"ST7789 not yet implemented"); return DV_OK; }
    if (cfg->i2c_sda<0||cfg->i2c_scl<0) return DV_ERR_INVALID_ARG;

    i2c_master_bus_config_t bc={ .i2c_port=-1, .sda_io_num=cfg->i2c_sda, .scl_io_num=cfg->i2c_scl,
        .clk_source=I2C_CLK_SRC_DEFAULT, .glitch_ignore_cnt=7, .flags.enable_internal_pullup=true };
    if (i2c_new_master_bus(&bc,&s_bus)!=ESP_OK) return DV_ERR;
    i2c_device_config_t dc={ .dev_addr_length=I2C_ADDR_BIT_LEN_7, .device_address=cfg->i2c_addr, .scl_speed_hz=400000 };
    if (i2c_master_bus_add_device(s_bus,&dc,&s_dev)!=ESP_OK) return DV_ERR;

    static const uint8_t init[]={0xAE,0x20,0x00,0xB0,0xC8,0x00,0x10,0x40,0x81,0x7F,0xA1,0xA6,
        0xA8,0x3F,0xA4,0xD3,0x00,0xD5,0x80,0xD9,0xF1,0xDA,0x12,0xDB,0x40,0x8D,0x14,0xAF};
    for(size_t i=0;i<sizeof(init);i++) ssd1306_cmd(init[i]);
    memset(s_fb,0,sizeof(s_fb)); ssd1306_flush();
    s_ready=true;
    ESP_LOGI(TAG,"SSD1306 %dx%d up on SDA%d/SCL%d",cfg->disp_width,cfg->disp_height,cfg->i2c_sda,cfg->i2c_scl);
    return DV_OK;
}

bool display_available(void){ return s_ready; }

static void draw_char(int x,int page,char c){
    if(c<0x20||c>0x7A) c=' ';
    const uint8_t *g=FONT5x7[c-0x20];
    for(int i=0;i<5;i++){ int px=x+i; if(px<0||px>=s_cfg.disp_width)continue; s_fb[page*s_cfg.disp_width+px]=g[i]; }
}
void display_text(int line,const char *str){
    if(!s_ready||line<0||line>=(s_cfg.disp_height/8)) return;
    memset(s_fb+line*s_cfg.disp_width,0,s_cfg.disp_width);
    int x=0; for(const char *p=str;*p&&x<s_cfg.disp_width-6;p++){ draw_char(x,line,*p); x+=6; }
    ssd1306_flush();
}
void display_clear(void){ if(!s_ready)return; memset(s_fb,0,sizeof(s_fb)); ssd1306_flush(); }
void display_title(const char *s){ display_text(0,s); }

void display_confirm_screen(const dv_tx_review_t *tx,int page,int pages){
    if(!s_ready) return;
    memset(s_fb,0,sizeof(s_fb));
    char l[24];
    snprintf(l,sizeof(l),"CONFIRM %d/%d",page+1,pages); draw_char(0,0,0); display_text(0,l);
    if(page==0){ display_text(1,"To:"); char t[22]; snprintf(t,sizeof(t),"%.20s",tx->to); display_text(2,t);
                 display_text(3,tx->to+20); }
    else if(page==1){ display_text(1,"Amount:"); display_text(2,tx->amount); display_text(3,tx->symbol); }
    else { display_text(1,"Fee:"); display_text(2,tx->fee); display_text(4,"OK=confirm  X=cancel"); }
    ssd1306_flush();
}

void display_show_qr(const uint8_t *data,size_t len){ (void)data;(void)len; /* TODO: QR raster */ }
